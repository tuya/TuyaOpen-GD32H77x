## Kconfig
```kconfig
# GD32H77X platform-owned configuration.
#
# Parsed by platform_config.py to generate gd32h77x_config.h and
# gd32h77x_config.cmake.
menu "configure platform [GD32H77X]"

choice
    prompt "Default flashing backend"
    default ENABLE_GD32H77X_FLASH_BACKEND_SWD

    config ENABLE_GD32H77X_FLASH_BACKEND_SWD
        bool "swd"
        help
          CMSIS-DAP with the GigaDevice GD32H77x CMSIS-Pack.

    config ENABLE_GD32H77X_FLASH_BACKEND_DFU
        bool "dfu"
        help
          GD32 ROM USB DFU.

    config ENABLE_GD32H77X_FLASH_BACKEND_UART
        bool "uart"
        help
          GD32 ROM system-memory UART ISP.
endchoice

config ENABLE_GD32H77X_FLASH_DFU_AUTOSTART
    bool "Start application after successful DFU flashing"
    depends on ENABLE_GD32H77X_FLASH_BACKEND_DFU
    default n
    help
      Send the ROM DfuSe leave command after programming and verification.
      BOOT must be low for subsequent hardware resets to start the application.

config GD32H77X_PMU_SMPS_MODE
    string "VCORE PMU supply mode"
    default ""
    help
      Board power-topology selector. Leave empty to preserve the vendor
      reset/default PMU configuration. Use "bypass" when VCORE is supplied by
      an external regulator and the internal SMPS is not used; use "direct"
      when the internal SMPS supplies VCORE.

config ENABLE_GD32H77X_POWER_HOLD
    bool "Assert power hold GPIO during early platform initialization"
    default n

config GD32H77X_POWER_HOLD_GPIO
    string "Power hold GPIO"
    depends on ENABLE_GD32H77X_POWER_HOLD
    default "PC13"

config ENABLE_GD32H77X_POWER_HOLD_ACTIVE_HIGH
    bool "Power hold is active high"
    depends on ENABLE_GD32H77X_POWER_HOLD
    default y

menu "Console UART binding"

choice
    prompt "Console UART peripheral"
    default ENABLE_GD32H77X_CONSOLE_UART_USART5

    config ENABLE_GD32H77X_CONSOLE_UART_USART0
        bool "USART0"
    config ENABLE_GD32H77X_CONSOLE_UART_USART1
        bool "USART1"
    config ENABLE_GD32H77X_CONSOLE_UART_USART2
        bool "USART2"
    config ENABLE_GD32H77X_CONSOLE_UART_UART3
        bool "UART3"
    config ENABLE_GD32H77X_CONSOLE_UART_UART4
        bool "UART4"
    config ENABLE_GD32H77X_CONSOLE_UART_USART5
        bool "USART5"
    config ENABLE_GD32H77X_CONSOLE_UART_UART6
        bool "UART6"
    config ENABLE_GD32H77X_CONSOLE_UART_UART7
        bool "UART7"
endchoice

choice
    prompt "Console GPIO port"
    default ENABLE_GD32H77X_CONSOLE_GPIO_PORT_C

    config ENABLE_GD32H77X_CONSOLE_GPIO_PORT_A
        bool "GPIOA"
    config ENABLE_GD32H77X_CONSOLE_GPIO_PORT_B
        bool "GPIOB"
    config ENABLE_GD32H77X_CONSOLE_GPIO_PORT_C
        bool "GPIOC"
    config ENABLE_GD32H77X_CONSOLE_GPIO_PORT_D
        bool "GPIOD"
    config ENABLE_GD32H77X_CONSOLE_GPIO_PORT_E
        bool "GPIOE"
    config ENABLE_GD32H77X_CONSOLE_GPIO_PORT_F
        bool "GPIOF"
    config ENABLE_GD32H77X_CONSOLE_GPIO_PORT_G
        bool "GPIOG"
    config ENABLE_GD32H77X_CONSOLE_GPIO_PORT_H
        bool "GPIOH"
    config ENABLE_GD32H77X_CONSOLE_GPIO_PORT_J
        bool "GPIOJ"
    config ENABLE_GD32H77X_CONSOLE_GPIO_PORT_K
        bool "GPIOK"
endchoice

config GD32H77X_CONSOLE_TX_PIN_NUMBER
    int "Console TX pin"
    range 0 15
    default 6
    help
      GPIO pin number on the selected console GPIO port.

config GD32H77X_CONSOLE_RX_PIN_NUMBER
    int "Console RX pin"
    range 0 15
    default 7
    help
      GPIO pin number on the selected console GPIO port.

config GD32H77X_CONSOLE_AF_NUMBER
    int "Console alternate function"
    range 0 31
    default 7
    help
      GD32 alternate-function number used by both console pins.

endmenu

menu "AT transport binding"

choice
    prompt "AT transport"
    default ENABLE_GD32H77X_AT_TRANSPORT_UART

    config ENABLE_GD32H77X_AT_TRANSPORT_UART
        bool "UART AT transport"

    config ENABLE_GD32H77X_AT_TRANSPORT_SPI
        bool "SPI AT transport"
endchoice

choice
    prompt "AT SPI clock prescaler"
    default ENABLE_GD32H77X_AT_SPI_PSC_256

    config ENABLE_GD32H77X_AT_SPI_PSC_16
        bool "/16 (18.75 MHz on 300 MHz PLL0Q)"
    config ENABLE_GD32H77X_AT_SPI_PSC_64
        bool "/64"
    config ENABLE_GD32H77X_AT_SPI_PSC_128
        bool "/128"
    config ENABLE_GD32H77X_AT_SPI_PSC_256
        bool "/256 (slow and conservative)"
endchoice

config ENABLE_GD32H77X_AT_SPI_CS_ONLY
    bool "SPI AT v2: active-low CS polling, without READY"
    depends on ENABLE_GD32H77X_AT_TRANSPORT_SPI
    default n
    help
      Requires matching VW553 CS_ONLY firmware. The old REQUEST pin becomes
      active-low CS; READY is neither configured nor sampled. Version 2 frames
      prevent accidentally communicating with the legacy READY-based peer.

config GD32H77X_AT_SPI_NUMBER
    int "AT SPI controller (0..5)"
    range 0 5
    default 3
    help
      Signal routes are checked against at_routes.py during configuration
      generation. AF, clock source, reset gate and DMA requests are derived.

config GD32H77X_AT_SPI_SCK
    string "AT SPI SCK route (e.g. PB13)"
    default "PE2"
    help
      Ordinary-pad name from the verified controller routing catalogue.
      Invalid routes and H779 package conflicts stop the build before compile.

config GD32H77X_AT_SPI_MISO
    string "AT SPI MISO route (e.g. PB14)"
    default "PE5"

config GD32H77X_AT_SPI_MOSI
    string "AT SPI MOSI route (e.g. PB15)"
    default "PE6"

config GD32H77X_AT_SPI_CS
    string "AT SPI active-low CS GPIO"
    default "PE4"

config GD32H77X_AT_SPI_READY
    string "AT SPI READY GPIO (legacy protocol only)"
    default "PE3"

menu "AT UART binding"

choice
    prompt "AT UART peripheral"
    default ENABLE_GD32H77X_AT_UART_UART4

    config ENABLE_GD32H77X_AT_UART_USART0
        bool "USART0"
    config ENABLE_GD32H77X_AT_UART_USART1
        bool "USART1"
    config ENABLE_GD32H77X_AT_UART_USART2
        bool "USART2"
    config ENABLE_GD32H77X_AT_UART_UART3
        bool "UART3"
    config ENABLE_GD32H77X_AT_UART_UART4
        bool "UART4"
    config ENABLE_GD32H77X_AT_UART_USART5
        bool "USART5"
    config ENABLE_GD32H77X_AT_UART_UART6
        bool "UART6"
    config ENABLE_GD32H77X_AT_UART_UART7
        bool "UART7"
endchoice

choice
    prompt "AT UART GPIO port"
    default ENABLE_GD32H77X_AT_GPIO_PORT_B

    config ENABLE_GD32H77X_AT_GPIO_PORT_A
        bool "GPIOA"
    config ENABLE_GD32H77X_AT_GPIO_PORT_B
        bool "GPIOB"
    config ENABLE_GD32H77X_AT_GPIO_PORT_C
        bool "GPIOC"
    config ENABLE_GD32H77X_AT_GPIO_PORT_D
        bool "GPIOD"
    config ENABLE_GD32H77X_AT_GPIO_PORT_E
        bool "GPIOE"
    config ENABLE_GD32H77X_AT_GPIO_PORT_F
        bool "GPIOF"
    config ENABLE_GD32H77X_AT_GPIO_PORT_G
        bool "GPIOG"
    config ENABLE_GD32H77X_AT_GPIO_PORT_H
        bool "GPIOH"
    config ENABLE_GD32H77X_AT_GPIO_PORT_J
        bool "GPIOJ"
    config ENABLE_GD32H77X_AT_GPIO_PORT_K
        bool "GPIOK"
endchoice

config GD32H77X_AT_TX_PIN_NUMBER
    int "AT TX pin"
    range 0 15
    default 13
    help
      GPIO pin number on the selected AT UART GPIO port.

config GD32H77X_AT_RX_PIN_NUMBER
    int "AT RX pin"
    range 0 15
    default 12
    help
      GPIO pin number on the selected AT UART GPIO port.

config GD32H77X_AT_AF_NUMBER
    int "Legacy AT UART alternate function (ignored by explicit routes)"
    range 0 31
    default 14
    help
      GD32 alternate-function number used by both AT UART pins.

config GD32H77X_AT_UART_TX_ROUTE
    string "AT UART TX route (empty uses legacy GPIO settings)"
    default ""
    help
      Enter a datasheet pin name such as PA9. AF is derived automatically.
      TX and RX may use different GPIO ports and AF numbers.

config GD32H77X_AT_UART_RX_ROUTE
    string "AT UART RX route (empty uses legacy GPIO settings)"
    default ""

config GD32H77X_AT_BAUD
    int "AT UART baud rate"
    range 1200 4000000
    default 115200

config GD32H77X_AT_IRQ_PRIORITY
    int "AT UART IRQ priority"
    range 5 15
    default 6
    help
      Must remain at or below the FreeRTOS maximum syscall priority.

config ENABLE_GD32H77X_AT_SHARED_RESET
    bool "AT module reset is connected to the host reset"
    default n
    help
      Disable module GPIO reset pulses when they would reset the host too.

choice
    prompt "AT reset GPIO port"
    default ENABLE_GD32H77X_AT_RESET_GPIO_PORT_C

    config ENABLE_GD32H77X_AT_RESET_GPIO_PORT_A
        bool "GPIOA"
    config ENABLE_GD32H77X_AT_RESET_GPIO_PORT_B
        bool "GPIOB"
    config ENABLE_GD32H77X_AT_RESET_GPIO_PORT_C
        bool "GPIOC"
    config ENABLE_GD32H77X_AT_RESET_GPIO_PORT_D
        bool "GPIOD"
    config ENABLE_GD32H77X_AT_RESET_GPIO_PORT_E
        bool "GPIOE"
    config ENABLE_GD32H77X_AT_RESET_GPIO_PORT_F
        bool "GPIOF"
    config ENABLE_GD32H77X_AT_RESET_GPIO_PORT_G
        bool "GPIOG"
    config ENABLE_GD32H77X_AT_RESET_GPIO_PORT_H
        bool "GPIOH"
    config ENABLE_GD32H77X_AT_RESET_GPIO_PORT_J
        bool "GPIOJ"
    config ENABLE_GD32H77X_AT_RESET_GPIO_PORT_K
        bool "GPIOK"
endchoice

config GD32H77X_AT_RESET_PIN_NUMBER
    int "AT reset pin"
    range 0 15
    default 5
    help
      GPIO pin number on the selected AT reset GPIO port.

choice
    prompt "SD card SDIO host"
    default ENABLE_GD32H77X_SDIO_HOST_0

    config ENABLE_GD32H77X_SDIO_HOST_0
        bool "SDIO0"
    config ENABLE_GD32H77X_SDIO_HOST_1
        bool "SDIO1"
endchoice

endmenu

endmenu


menu "External PSRAM"

config ENABLE_GD32H77X_PSRAM
    bool "Enable external PSRAM on OSPI0"
    default n
    help
      Enable the GD32H77X OSPI0 PSRAM controller, device profile and TKL
      PSRAM heap. Boards without PSRAM must leave this disabled.

config GD32H77X_PSRAM_PROFILE
    string "PSRAM device profile"
    depends on ENABLE_GD32H77X_PSRAM
    default "APS6404L-3SQR"
    help
      Verified PSRAM profile name. The profile owns device-specific commands,
      reset sequence, dummy cycles and timing limits.

choice
    prompt "PSRAM access mode"
    depends on ENABLE_GD32H77X_PSRAM
    default GD32H77X_PSRAM_ACCESS_INDIRECT

    config GD32H77X_PSRAM_ACCESS_INDIRECT
        bool "indirect"
        help
          Access PSRAM only through the explicit offset-based read/write API.
          The OSPI memory-mapped window stays disabled. This mode supports
          arbitrary byte offsets and lengths at the cost of CPU-polled copies.

    config GD32H77X_PSRAM_ACCESS_MAPPED
        bool "memory-mapped"
        help
          Enter the OSPI memory-mapped window. This requires every access path
          to satisfy the device and Cortex-M7 mapping constraints and is not
          yet accepted for a general-purpose PSRAM heap on this board.
endchoice

choice
    prompt "PSRAM OSPIM port"
    depends on ENABLE_GD32H77X_PSRAM
    default GD32H77X_PSRAM_OSPIM_PORT0

    config GD32H77X_PSRAM_OSPIM_PORT0
        bool "OSPIM Port 0"

    config GD32H77X_PSRAM_OSPIM_PORT1
        bool "OSPIM Port 1"
endchoice

config GD32H77X_PSRAM_CS_PIN
    string "PSRAM CS pin"
    depends on ENABLE_GD32H77X_PSRAM
    default ""

config GD32H77X_PSRAM_SCK_PIN
    string "PSRAM SCK pin"
    depends on ENABLE_GD32H77X_PSRAM
    default ""

config GD32H77X_PSRAM_IO0_PIN
    string "PSRAM IO0 pin"
    depends on ENABLE_GD32H77X_PSRAM
    default ""

config GD32H77X_PSRAM_IO1_PIN
    string "PSRAM IO1 pin"
    depends on ENABLE_GD32H77X_PSRAM
    default ""

config GD32H77X_PSRAM_IO2_PIN
    string "PSRAM IO2 pin"
    depends on ENABLE_GD32H77X_PSRAM
    default ""

config GD32H77X_PSRAM_IO3_PIN
    string "PSRAM IO3 pin"
    depends on ENABLE_GD32H77X_PSRAM
    default ""

config GD32H77X_PSRAM_IO4_PIN
    string "PSRAM IO4 pin"
    depends on ENABLE_GD32H77X_PSRAM
    default ""
    help
      Required for eight-line PSRAM profiles. Leave empty for four-line devices.

config GD32H77X_PSRAM_IO5_PIN
    string "PSRAM IO5 pin"
    depends on ENABLE_GD32H77X_PSRAM
    default ""
    help
      Required for eight-line PSRAM profiles. Leave empty for four-line devices.

config GD32H77X_PSRAM_IO6_PIN
    string "PSRAM IO6 pin"
    depends on ENABLE_GD32H77X_PSRAM
    default ""
    help
      Required for eight-line PSRAM profiles. Leave empty for four-line devices.

config GD32H77X_PSRAM_IO7_PIN
    string "PSRAM IO7 pin"
    depends on ENABLE_GD32H77X_PSRAM
    default ""
    help
      Required for eight-line PSRAM profiles. Leave empty for four-line devices.

config GD32H77X_PSRAM_DQS_PIN
    string "PSRAM DQS pin"
    depends on ENABLE_GD32H77X_PSRAM
    default ""
    help
      Required for DQS-gated eight-line PSRAM profiles.

config GD32H77X_PSRAM_RESET_PIN
    string "PSRAM hardware reset pin"
    depends on ENABLE_GD32H77X_PSRAM
    default ""
    help
      Optional active-low PSRAM hardware reset GPIO. Leave empty when the
      device reset pin is tied high or not connected.

config GD32H77X_PSRAM_CLOCK_HZ
    int "PSRAM clock in Hz"
    depends on ENABLE_GD32H77X_PSRAM
    range 1000000 133000000
    default 75000000

config GD32H77X_PSRAM_SIZE_MB
    int "PSRAM capacity in MiB"
    depends on ENABLE_GD32H77X_PSRAM
    range 1 64
    default 8

config GD32H77X_PSRAM_HEAP_OFFSET_KB
    int "PSRAM runtime heap offset in KiB"
    depends on ENABLE_GD32H77X_PSRAM
    range 0 65536
    default 4096

config GD32H77X_PSRAM_HEAP_SIZE_KB
    int "PSRAM runtime heap size in KiB"
    depends on ENABLE_GD32H77X_PSRAM
    range 1 65536
    default 4096

endmenu

endmenu
```
